## boards/shields/Corne_dongle/Kconfig.shield
```kconfig
# Copyright (c) 2020 The ZMK Contributors
# SPDX-License-Identifier: MIT

config SHIELD_CORNE_DONGLE_CENTRAL
    def_bool $(shields_list_contains,Corne_dongle_central)

config SHIELD_CORNE_DONGLE_LEFT
    def_bool $(shields_list_contains,Corne_dongle_left)

config SHIELD_CORNE_DONGLE_RIGHT
    def_bool $(shields_list_contains,Corne_dongle_right)
```

## boards/shields/Lily58_dongle/Kconfig.shield
```kconfig
# Copyright (c) 2020 The ZMK Contributors
# SPDX-License-Identifier: MIT

config SHIELD_LILY58_DONGLE_CENTRAL
    def_bool $(shields_list_contains,Lily58_dongle_central)

config SHIELD_LILY58_DONGLE_LEFT
    def_bool $(shields_list_contains,Lily58_dongle_left)

config SHIELD_LILY58_DONGLE_RIGHT
    def_bool $(shields_list_contains,Lily58_dongle_right)
```
